/dts-v1/;
/plugin/;

/ {
    compatible = "raspberrypi,model-zero-w", "brcm,bcm2835";
    fragment@0 {
        target-path = "/";
        __overlay__ {
            rpi0w-led {
                compatible = "rpi0w-led";
                status = "okay";
                gpios = <&gpio 4 GPIO_ACTIVE_HIGH>;
            };
        };
    };
};
