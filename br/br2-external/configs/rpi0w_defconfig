## br/br2-external/configs/rpi0w_defconfig
```kconfig
BR2_arm=y
BR2_arm1176jzf_s=y
BR2_KERNEL_HEADERS_6_1=y
BR2_TOOLCHAIN_BUILDROOT_CXX=y
BR2_CCACHE=y
BR2_TARGET_GENERIC_HOSTNAME="rpi0w"
BR2_TARGET_GENERIC_ROOT_PASSWD="123"
BR2_ROOTFS_OVERLAY="$(BR2_EXTERNAL)/board/rpi0w/rootfs_overlay"
BR2_ROOTFS_POST_BUILD_SCRIPT="$(BR2_EXTERNAL)/board/rpi0w/post-build.sh"
BR2_ROOTFS_POST_IMAGE_SCRIPT="$(BR2_EXTERNAL)/board/rpi0w/post-image.sh"
BR2_LINUX_KERNEL=y
BR2_LINUX_KERNEL_CUSTOM_GIT=y
BR2_LINUX_KERNEL_CUSTOM_REPO_URL="https://github.com/raspberrypi/linux"
BR2_LINUX_KERNEL_CUSTOM_REPO_VERSION="rpi-6.1.y"
BR2_LINUX_KERNEL_PATCH="$(BR2_EXTERNAL)/board/rpi0w/linux-patches"
BR2_LINUX_KERNEL_USE_CUSTOM_CONFIG=y
BR2_LINUX_KERNEL_CUSTOM_CONFIG_FILE="$(BR2_EXTERNAL)/board/rpi0w/linux.config"
BR2_LINUX_KERNEL_DTS_SUPPORT=y
BR2_LINUX_KERNEL_INTREE_DTS_NAME="bcm2708-rpi-zero-w"
BR2_LINUX_KERNEL_NEEDS_HOST_OPENSSL=y
BR2_PACKAGE_BUSYBOX_CONFIG="$(BR2_EXTERNAL)/board/rpi0w/busybox.config"
BR2_PACKAGE_BUSYBOX_SHOW_OTHERS=y
BR2_PACKAGE_BINUTILS=y
BR2_PACKAGE_BINUTILS_TARGET=y
BR2_PACKAGE_SED=y
BR2_PACKAGE_BRCMFMAC_SDIO_FIRMWARE_RPI=y
BR2_PACKAGE_BRCMFMAC_SDIO_FIRMWARE_RPI_BT=y
BR2_PACKAGE_BRCMFMAC_SDIO_FIRMWARE_RPI_WIFI=y
BR2_PACKAGE_RPI_FIRMWARE=y
BR2_PACKAGE_RPI_FIRMWARE_BOOTCODE_BIN=y
BR2_PACKAGE_RPI_FIRMWARE_VARIANT_PI=y
BR2_PACKAGE_RPI_FIRMWARE_CONFIG_FILE="$(BR2_EXTERNAL)/board/rpi0w/config.txt"
BR2_PACKAGE_RNG_TOOLS=y
BR2_PACKAGE_DHCPCD=y
BR2_PACKAGE_OPENSSH=y
BR2_PACKAGE_WPA_SUPPLICANT=y
BR2_PACKAGE_FILE=y
BR2_PACKAGE_VIM=y
BR2_TARGET_ROOTFS_EXT2=y
BR2_TARGET_ROOTFS_EXT2_4=y
BR2_TARGET_ROOTFS_EXT2_SIZE="1024M"
# BR2_TARGET_ROOTFS_TAR is not set
BR2_TARGET_UBOOT=y
BR2_TARGET_UBOOT_USE_CUSTOM_CONFIG=y
BR2_TARGET_UBOOT_CUSTOM_CONFIG_FILE="$(BR2_EXTERNAL)/board/rpi0w/uboot.config"
BR2_PACKAGE_HOST_DOSFSTOOLS=y
BR2_PACKAGE_HOST_DTC=y
BR2_PACKAGE_HOST_GENIMAGE=y
BR2_PACKAGE_HOST_MTOOLS=y
BR2_PACKAGE_HOST_UBOOT_TOOLS=y
BR2_PACKAGE_HOST_UBOOT_TOOLS_BOOT_SCRIPT=y
BR2_PACKAGE_HOST_UBOOT_TOOLS_BOOT_SCRIPT_SOURCE="$(BR2_EXTERNAL)/board/rpi0w/boot.cmd"
```

## br/br2-external/package/bmp280-cli/Config.in
```kconfig
config BR2_PACKAGE_BMP280_CLI
	bool "bmp280-cli"
	help
	  A CLI to interact with the bmp280-i2c driver
```

## br2-external/Config.in
```kconfig
menu "Rpi0w external packages"
	source "$BR2_EXTERNAL_RPI0W_PACKAGES_PATH/package/rpi0w-led-user/Config.in"
	source "$BR2_EXTERNAL_RPI0W_PACKAGES_PATH/package/rpi0w-led-kern/Config.in"
	source "$BR2_EXTERNAL_RPI0W_PACKAGES_PATH/package/bmp280-i2c/Config.in"
	source "$BR2_EXTERNAL_RPI0W_PACKAGES_PATH/package/bmp280-cli/Config.in"
endmenu
```

## br2-external/package/rpi0w-led-user/Config.in
```kconfig
config BR2_PACKAGE_RPI0W_LED_USER
	bool "rpi0w-led-user"
	help
	  A userspace program to use an external LED on rpi0w
```

## buildroot/br2-external/Config.in
```kconfig
menu "Rpi0w external packages"
	source "$BR2_EXTERNAL_RPI0W_PACKAGES_PATH/package/rpi0w-led-user/Config.in"
	source "$BR2_EXTERNAL_RPI0W_PACKAGES_PATH/package/rpi0w-led-kern/Config.in"
endmenu
```

## buildroot/br2-external/package/bmp280-i2c/Config.in
```kconfig
config BR2_PACKAGE_BMP280_I2C
	bool "bmp280-i2c"
	help
	  Driver for the BMP280 pressure and temperature sensor
```

## buildroot/br2-external/package/rpi0w-led-kern/Config.in
```kconfig
config BR2_PACKAGE_RPI0W_LED_KERN
	bool "rpi0w-led-kern"
	depends on BR2_LINUX_KERNEL
	help
	  Linux driver to control an external LED on rpi0w
```

## buildroot/packages/rpi0w-led-user/Config.in
```kconfig
config BR2_PACKAGE_RPI0W_LED
	bool "rpi0w-led"
	help
		The program to blink an external LED
```

## yocto/layers/meta-raspberrypi-custom/conf/distro/rpi-dist.conf
```bitbake
require conf/distro/poky.conf

DISTRO = "rpi-dist"
DISTRO_NAME = "Custom rpi distro"

DESCRIPTION = "Custom distro for delopment on raspberrypi"

DISTRO_FEATURES += "wifi"

INIT_MANAGER = "systemd"
VIRTUAL-RUNTIME_syslog = ""
VIRTUAL-RUNTIME_base-utils-syslog = ""

# KERNEL_MODULE_AUTOLOAD = "brcmutil brcmfmac"
```

## yocto/sources/meta-raspberrypi-custom/conf/layer.conf
```bitbake
# We have a conf and classes directory, add to BBPATH
BBPATH .= ":${LAYERDIR}"

# We have recipes-* directories, add to BBFILES
BBFILES += "${LAYERDIR}/recipes-*/*/*.bb \
            ${LAYERDIR}/recipes-*/*/*.bbappend"

BBFILE_COLLECTIONS += "meta-raspberrypi-custom"
BBFILE_PATTERN_meta-raspberrypi-custom = "^${LAYERDIR}/"
BBFILE_PRIORITY_meta-raspberrypi-custom = "6"

LAYERDEPENDS_meta-raspberrypi-custom = "core"
LAYERSERIES_COMPAT_meta-raspberrypi-custom = "mickledore"
```
